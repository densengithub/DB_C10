## 20190215_Ctrlboard_SDK_v2.3.2.1_d22119/ite_sdk/project/test_canbus/Kconfig
```kconfig
#
# For a description of the syntax of this configuration file,
# see Documentation/kbuild/kconfig-language.txt.
#

mainmenu "Project Configuration"

config TEST_UART
    bool
    default y
    #select HAVE_LCD
    #select HAVE_GRAPHICS
    #select HAVE_AUDIO
    #select HAVE_VIDEO

config DEF_CHIP_PKG_IT976
    def_bool y

config DEF_CHIP_REV_A0
    def_bool y

config RAM_INIT_SCRIPT
    default "IT970A0_396Mhz_DDR2_200Mhz.scr"

config CMAKE_SOURCE_DIR
    string
    option env="CMAKE_SOURCE_DIR"

config FS_FAT
    def_bool n

config UART1_ENABLE
    def_bool y

config GPIO_UART1_TX
    default "4"

config GPIO_UART1_RX
    default "-1"

config NOR_ENABLE
    def_bool n

config SPI0_ENABLE
    def_bool y

config SPI1_ENABLE
    def_bool n

config SPI0_MISO_GPIO
    default "28"

config SPI0_MOSI_GPIO
    default "27"

config SPI0_CLOCK_GPIO
    default "25"

config SPI0_CHIP_SEL_GPIO
    default "26"

config DEF_DBG_UART1
    def_bool y

config CANBUS_ENABLE
    def_bool y

config DBG_INIT_SCRIPT
    default "IT970A0_396Mhz_DDR2_200Mhz.txt"

source "$CMAKE_SOURCE_DIR/sdk/Kconfig"
```

## 20190215_Ctrlboard_SDK_v2.3.2.1_d22119/ite_sdk/project/test_cap/Kconfig
```kconfig
#
# For a description of the syntax of this configuration file,
# see Documentation/kbuild/kconfig-language.txt.
#

mainmenu "Project Configuration"

config TEST_CAP
    bool
    default y
    select HAVE_LCD
    select HAVE_GRAPHICS
    select HAVE_VIDEO
    select HAVE_AUDIO

config CMAKE_SOURCE_DIR
    string
    option env="CMAKE_SOURCE_DIR"

config DEF_CHIP_PKG_IT976
    def_bool y

config DEF_CHIP_REV_A0
    def_bool y

config DEF_CPU_FA626
    def_bool y

config RAM_SIZE
    default "0x4000000"

config RAM_INIT_SCRIPT
    default "IT970A0_396Mhz_DDR2_200Mhz.scr"

config LCD_ENABLE
    def_bool y

config LCD_WIDTH
    default "800"

config LCD_HEIGHT
    default "480"

config LCD_PITCH
    default "1600"

config LCD_INIT_SCRIPT
    default "it970_lcd_innolux_800_480_24bits_rgb_144pin.txt"

config BACKLIGHT_ENABLE
    def_bool y

config BACKLIGHT_DUTY_CYCLES
    default "95, 92, 88, 82, 75, 65, 55, 40, 25, 5"

config GPIO_BACKLIGHT_PWM
     default "95"

config BACKLIGHT_DEFAULT_DUTY_CYCLE
    default "5"

config DBG_INIT_SCRIPT
    default "IT970A0_396Mhz_DDR2_200Mhz.txt"

config I2C1_ENABLE
    def_bool y

config GPIO_IIC1_CLK
    default "66"

config GPIO_IIC1_DATA
    default "65"

config GPIO_IIC1_MODE
    default "4"

config UART0_ENABLE
    def_bool n

config UART1_ENABLE
    def_bool y

config GPIO_UART1_TX
    default "4"

config GPIO_UART1_RX
    default "-1"

#config BUILD_FFMPEG
#    def_bool y

config CAPTURE_DEFINE
    default "EVB_977_NT99141.txt"

config SENSOR_ENABLE
    def_bool y

config DEF_SENSOR_NOVATEK_NT99141
    def_bool y

config DEF_SENSOR_FLICK_50HZ
     def_bool y

config GPIO_SN1_RST
    default "63"

config GPIO_SN1_PWN
    default "52"

config GPIO_SN1_LED
    default "52"

config VIDEO_ENABLE
    def_bool y

config STC_ENABLE
    def_bool y

config FS_FAT
    def_bool y

config ITU_UCL_ENABLE
    def_bool y

config BUILD_INIPARSER
    def_bool y

config BUILD_ITU
    def_bool y

config BUILD_SDL
    def_bool y

config TASK_DRIVE_PROBE
    def_bool y

config RECORD_VIDEO
    def_bool y


source "$CMAKE_SOURCE_DIR/sdk/Kconfig"


menu "CAP TEST FUNCTION"

    choice
        prompt "Test CAP"
        default CAP_SENSOR_MEM_MODE

    config CAP_SENSOR_MEM_MODE
        bool "CAP_SENSOR_MEM_MODE"
        help
            Peripheral->SENSOR ENABLE = true
    config CAP_HDMIRX_MODE
        bool "CAP_HDMIRX_MODE"
        help
            Peripheral->HDMI RX ENABLE = true
    config CAP_MODULE_MODE
        bool "CAP_MODULE_MODE"
        help
            Peripheral->CAPTURE_MODULE_ENABLE = true
    endchoice

endmenu
```

## 20190215_Ctrlboard_SDK_v2.3.2.1_d22119/ite_sdk/project/test_cap/Kconfig.win32
```kconfig
#
# For a description of the syntax of this configuration file,
# see Documentation/kbuild/kconfig-language.txt.
#

mainmenu "Project Configuration"


config TEST_VIDEO
    bool
    default y
    select HAVE_LCD
    select HAVE_GRAPHICS
    select HAVE_VIDEO

config LCD_ENABLE
    def_bool y

config VIDEO_ENABLE
    def_bool y

config CMAKE_SOURCE_DIR
    string
    option env="CMAKE_SOURCE_DIR"

config DEF_CHIP_PKG_IT976
    def_bool y

config DEF_CHIP_REV_A0
    def_bool y

config DEF_CPU_FA626
    def_bool y

config LCD_ENABLE
    def_bool y

config LCD_WIDTH
    default "800"

config LCD_HEIGHT
    default "480"

config LCD_PITCH
    default "1600"

config LCD_INIT_SCRIPT
    default "it970_lcd_innolux_800_480_24bits_rgb_144pin.txt"

config DBG_INIT_SCRIPT
    default "IT970A0_396Mhz_DDR2_200Mhz.txt"

source "$CMAKE_SOURCE_DIR/sdk/Kconfig"
```

## 20190215_Ctrlboard_SDK_v2.3.2.1_d22119/ite_sdk/project/test_gpio/Kconfig
```kconfig
#
# For a description of the syntax of this configuration file,
# see Documentation/kbuild/kconfig-language.txt.
#

mainmenu "Project Configuration"

config TEST_GPIO
    bool
    default y

config CMAKE_SOURCE_DIR
	string
	option env="CMAKE_SOURCE_DIR"

config DEF_CHIP_PKG_IT976
    def_bool y

config DEF_CHIP_REV_A0
    def_bool y  

config RAM_SIZE
    default "0x4000000"

config RAM_INIT_SCRIPT
    default "IT970A0_396Mhz_DDR2_200Mhz.scr"
    
config UART0_ENABLE
    def_bool y

config GPIO_UART0_TX
    default "4"

config GPIO_UART0_RX
    default "-1"

config DEF_DBG_UART0
    def_bool y

config DBG_INIT_SCRIPT
    default "IT970A0_396Mhz_DDR2_200Mhz.txt"
    

source "$CMAKE_SOURCE_DIR/sdk/Kconfig"

menu "GPIO Test"

choice
	prompt "Test GPIO"
	default TEST_GPIO_INPUT

config TEST_GPIO_INPUT
	bool "TEST_GPIO_INPUT"
	config GPIO_TEST_INPUT_PIN
        string "INPUT_PIN"
        depends on TEST_GPIO_INPUT
        default 5
	
config TEST_GPIO_OUTPUT_TO_INPUT
	bool "TEST_GPIO_OUTPUT_TO_INPUT"
	config GPIO_TEST_INPUT_PIN
        string "INPUT_PIN"
        depends on TEST_GPIO_OUTPUT_TO_INPUT
        default 5
	config GPIO_TEST_OUTPUT_PIN
        string "OUTPUT_PIN"
        depends on TEST_GPIO_OUTPUT_TO_INPUT
        default 6

config TEST_GPIO_INTERRUPT
	bool "TEST_GPIO_INTERRUPT"
	config GPIO_TEST_INTR_PIN
        string "INTR_PIN"
        depends on TEST_GPIO_INTERRUPT
        default 5
		
config TEST_GPIO_EX_4
	bool "TEST_GPIO_EX_4"

endchoice

endmenu
```

## 20190215_Ctrlboard_SDK_v2.3.2.1_d22119/ite_sdk/project/test_input/Kconfig
```kconfig
#
# For a description of the syntax of this configuration file,
# see Documentation/kbuild/kconfig-language.txt.
#

mainmenu "Project Configuration"

config TEST_INPUT
    bool
    default y
    select HAVE_LCD
    select HAVE_GRAPHICS
    select HAVE_AUDIO
    select HAVE_VIDEO

config CMAKE_SOURCE_DIR
    string
    option env="CMAKE_SOURCE_DIR"

config DEF_CHIP_PKG_IT976
    def_bool y

config DEF_CHIP_REV_A0
    def_bool y

config RAM_SIZE
    default "0x4000000"

config RAM_INIT_SCRIPT
    default "IT970A0_396Mhz_DDR2_200Mhz.scr"

config DCPS_ENABLE
    def_bool y

config FONT_FILENAME
    default "WenQuanYiMicroHeiMono.ttf"

config BACKLIGHT_ENABLE
    def_bool y

config BACKLIGHT_DUTY_CYCLES
    default "95, 92, 88, 82, 75, 65, 55, 40, 25, 5"

config BACKLIGHT_DEFAULT_DUTY_CYCLE
    default "5"

config LCD_ENABLE
    def_bool y

config LCD_WIDTH
    default "1024"

config LCD_HEIGHT
    default "600"

config LCD_PITCH
    default "2048"

config LCD_INIT_SCRIPT
    default "it970_lcd_joyangit_1024_600_24bits_mipi_128pin_rot180.txt"

config LCD_TRIPLE_BUFFER
    default n

config CMDQ_ENABLE
    def_bool y

config M2D_ENABLE
    def_bool y

config JPEG_HW_ENABLE
    def_bool y

config AUDIO_ENABLE
    def_bool y

config AUDIO_DAC_MODULE
    default "itp_dac_ite970.c"

config AUDIO_CODEC_MP3DEC
    def_bool y

config AUDIO_CODEC_WMADEC
    def_bool y

config AUDIO_CODEC_WAV
    def_bool y

config VIDEO_ENABLE
    def_bool y

config KEYPAD_ENABLE
    def_bool n

config USB0_ENABLE
    def_bool y

config MSC_ENABLE
    def_bool y

config FS_FAT
    def_bool y

config I2C1_ENABLE
    def_bool y

config GPIO_IIC1_CLK
    default "37"

config GPIO_IIC1_DATA
    default "36"

config GPIO_IIC1_MODE
    default "2"

config TOUCH_ENABLE
    def_bool y

config TOUCH_MODULE
    default "gt911"

config TOUCH_X_MAX_VALUE
    default "0x3FF"

config TOUCH_Y_MAX_VALUE
    default "0x257"

config GPIO_TOUCH_INT
    default "38"

config GPIO_TOUCH_RESET
    default "39"

config GPIO_TOUCH_WAKE
    default "-1"

config DEF_TOUCH_I2C2
    def_bool y

config TOUCH_INTR
    def_bool y

config I2S_ENABLE
    def_bool y

config I2S_SPDIF_ENABLE
    def_bool n

config UART0_ENABLE
    def_bool y

config GPIO_UART0_TX
    default "4"

config GPIO_UART0_RX
    default "-1"

config GPIO_BACKLIGHT_PWM
    default "95"

config TASK_DRIVE_PROBE
    def_bool y

config DEF_DBG_UART0
    def_bool y

config DBG_INIT_SCRIPT
    default "IT970A0_396Mhz_DDR2_200Mhz.txt"

config ITU_FT_CACHE_ENABLE
    def_bool y

config ITU_FT_CACHE_SIZE
    default "0xFA000"

config BUILD_ITU
    def_bool y

config BUILD_AUDIO_MGR
    def_bool y

config BUILD_SDL
    def_bool y

source "$CMAKE_SOURCE_DIR/sdk/Kconfig"

menu "INPUT Test"

choice
    prompt "Test App"
    default BUILD_PYINPUT

config BUILD_PYINPUT
    bool "Input Test"

endchoice

endmenu
```

## 20190215_Ctrlboard_SDK_v2.3.2.1_d22119/ite_sdk/project/test_pattern_gen/Kconfig
```kconfig
#
# For a description of the syntax of this configuration file,
# see Documentation/kbuild/kconfig-language.txt.
#

mainmenu "Project Configuration"

config TEST_PTHREAD
    bool
    default y
    #select HAVE_LCD
    #select HAVE_GRAPHICS
    #select HAVE_AUDIO
    #select HAVE_VIDEO

config CMAKE_SOURCE_DIR
    string
    option env="CMAKE_SOURCE_DIR"

config DEF_CHIP_PKG_IT976
    def_bool y

config DEF_CHIP_REV_A0
    def_bool y

config RAM_SIZE
    default "0x4000000"

config RAM_INIT_SCRIPT
    default "IT970A0_396Mhz_DDR2_200Mhz.scr"

config UART1_ENABLE
    def_bool y

config GPIO_UART1_TX
    default "4"

config GPIO_UART1_RX
    default "-1"

config DEF_DBG_UART1
    def_bool y

config DBG_INIT_SCRIPT
    default "IT970A0_396Mhz_DDR2_200Mhz.txt"

config ALT_CPU_ENABLE
    def_bool y

config PATTERN_GEN
    def_bool y


source "$CMAKE_SOURCE_DIR/sdk/Kconfig"
```

## 20190215_Ctrlboard_SDK_v2.3.2.1_d22119/ite_sdk/project/test_pthread/Kconfig
```kconfig
#
# For a description of the syntax of this configuration file,
# see Documentation/kbuild/kconfig-language.txt.
#

mainmenu "Project Configuration"

config TEST_PTHREAD
    bool
    default y
    #select HAVE_LCD
    #select HAVE_GRAPHICS
    #select HAVE_AUDIO
    #select HAVE_VIDEO

config CMAKE_SOURCE_DIR
    string
    option env="CMAKE_SOURCE_DIR"

config DEF_CHIP_PKG_IT976
    def_bool y

config DEF_CHIP_REV_A0
    def_bool y

config RAM_SIZE
    default "0x4000000"

config RAM_INIT_SCRIPT
    default "IT970A0_396Mhz_DDR2_200Mhz.scr"

config UART0_ENABLE
    def_bool y

config GPIO_UART0_TX
    default "4"

config GPIO_UART0_RX
    default "-1"

config DEF_DBG_UART0
    def_bool y

config DBG_INIT_SCRIPT
    default "IT970A0_396Mhz_DDR2_200Mhz.txt"

source "$CMAKE_SOURCE_DIR/sdk/Kconfig"
```

## 20190215_Ctrlboard_SDK_v2.3.2.1_d22119/ite_sdk/project/test_rs485/Kconfig
```kconfig
#
# For a description of the syntax of this configuration file,
# see Documentation/kbuild/kconfig-language.txt.
#

mainmenu "Project Configuration"

config TEST_RS485
    bool
    default y

config CMAKE_SOURCE_DIR
    string
    option env="CMAKE_SOURCE_DIR"

config DEF_CHIP_PKG_IT976
    def_bool y

config RAM_INIT_SCRIPT
    default "IT970A0_396Mhz_DDR2_200Mhz.scr"

config UART0_ENABLE
    def_bool y

config GPIO_UART0_TX
    default "4"

config GPIO_UART0_RX
    default "-1"

config DEF_DBG_UART0
    def_bool y

config DBG_INIT_SCRIPT
    default "IT970A0_396Mhz_DDR2_200Mhz.txt"

config RS485_1_ENABLE
    def_bool y

config GPIO_RS485_1_TX
    default "52"

config GPIO_RS485_1_TX_ENABLE
    default "54"

config GPIO_RS485_1_RX
    default "53"

source "$CMAKE_SOURCE_DIR/sdk/Kconfig"
```

## 20190215_Ctrlboard_SDK_v2.3.2.1_d22119/ite_sdk/project/test_rtc/Kconfig
```kconfig
#
# For a description of the syntax of this configuration file,
# see Documentation/kbuild/kconfig-language.txt.
#

mainmenu "Project Configuration"

config TEST_RTC
    bool
    default y
    #select HAVE_LCD
    #select HAVE_GRAPHICS
    #select HAVE_AUDIO
    #select HAVE_VIDEO

config CMAKE_SOURCE_DIR
	string
	option env="CMAKE_SOURCE_DIR"

config FS_FAT
	def_bool n

config UART1_ENABLE
    def_bool y

config GPIO_UART1_TX
    default "4"

config GPIO_UART1_RX
    default "-1"

source "$CMAKE_SOURCE_DIR/sdk/Kconfig"
```

## 20190215_Ctrlboard_SDK_v2.3.2.1_d22119/ite_sdk/project/test_rtc/Kconfig.win32
```kconfig
#
# For a description of the syntax of this configuration file,
# see Documentation/kbuild/kconfig-language.txt.
#

mainmenu "Project Configuration"

config TEST_RTC
    bool
    default y
    #select HAVE_LCD
    #select HAVE_GRAPHICS
    #select HAVE_AUDIO
    #select HAVE_VIDEO

config CMAKE_SOURCE_DIR
    string
    option env="CMAKE_SOURCE_DIR"

config DEF_CHIP_PKG_IT976
    def_bool y

config RAM_INIT_SCRIPT
    default "IT970A0_396Mhz_DDR2_200Mhz.scr"

config RTC_ENABLE
    def_bool y

config DBG_INIT_SCRIPT
    default "IT970A0_396Mhz_DDR2_200Mhz.txt"

source "$CMAKE_SOURCE_DIR/sdk/Kconfig"

menu "RTC Test"

choice
    prompt "Test App"
    default TEST_RTC

config RTC_TEST
    bool "Enable Rtc Test"

endchoice

endmenu
```

## 20190215_Ctrlboard_SDK_v2.3.2.1_d22119/ite_sdk/project/test_saradc/Kconfig.win32
```kconfig
#
# For a description of the syntax of this configuration file,
# see Documentation/kbuild/kconfig-language.txt.
#

mainmenu "Project Configuration"

config DEF_CHIP_PKG_IT976
    def_bool y

config CMAKE_SOURCE_DIR
    string
    option env="CMAKE_SOURCE_DIR"

config AXISPI_ENABLE
    def_bool n

config SPI_ENABLE
    def_bool n

source "$CMAKE_SOURCE_DIR/sdk/Kconfig"
```

## 20190215_Ctrlboard_SDK_v2.3.2.1_d22119/ite_sdk/project/test_wifi_usb/Kconfig
```kconfig
#
# For a description of the syntax of this configuration file,
# see Documentation/kbuild/kconfig-language.txt.
#

mainmenu "Project Configuration"

config CMAKE_SOURCE_DIR
	string
	option env="CMAKE_SOURCE_DIR"

config DEF_CHIP_PKG_IT976
	def_bool y
	
config ROM_COMPRESS
	def_bool n

config UART1_ENABLE
	def_bool y
	
config GPIO_UART1_TX
	default "4"
	
config GPIO_UART1_RX
	default "-1"
#==== for USB ====
config USB0_ENABLE
	def_bool y
      
config USB1_ENABLE
	def_bool y
#==== for NET ====
config NET_ENABLE
	def_bool y
	
config NET_WIFI
	def_bool y

config DEF_NET_WIFI_8188EUS_NEW
	def_bool y
	
config NET_WIFI_WPA
	def_bool y
	
config NET_WIFI_MGR
	def_bool y

config NET_WIFI_REDEFINE
	def_bool y
	
config DHCPS_ADDR_COUNT
	default "254"
	
config DEF_BUILD_DEBUGREL
	def_bool y

config DBG_INIT_SCRIPT
    default "IT970A0_396Mhz_DDR2_200Mhz.txt"

source "$CMAKE_SOURCE_DIR/sdk/Kconfig"


menu "WIFI USB Test"

choice
	prompt "Test App"
	default TEST_USB_WIFI_RAW


config TEST_USB_WIFI_LWIP
	bool "Test by TCP socket"
	help
	    Connect to AP and test TCP

endchoice

endmenu
```
